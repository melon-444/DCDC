/**
 * @cliArgs --device "MSPM0G350X" --part "Default" --package "LQFP-64(PM)" --product "mspm0_sdk@2.02.00.05"
 * @versions {"tool":"1.21.1+3772"}
 */

/**
 * Import the modules used in this configuration.
 */
const ADC12   = scripting.addModule("/ti/driverlib/ADC12", {}, false);
const ADC121  = ADC12.addInstance();
const GPIO    = scripting.addModule("/ti/driverlib/GPIO", {}, false);
const GPIO1   = GPIO.addInstance();
const PWM     = scripting.addModule("/ti/driverlib/PWM", {}, false);
const PWM1    = PWM.addInstance();
const SYSCTL  = scripting.addModule("/ti/driverlib/SYSCTL");
const SYSTICK = scripting.addModule("/ti/driverlib/SYSTICK");

/**
 * Write custom configuration values to the imported modules.
 */
ADC121.$name                             = "ADC_SENSE";
ADC121.samplingOperationMode             = "sequence";
ADC121.endAdd                            = 1;
ADC121.adcMem0_name                      = "VBAT";
ADC121.adcMem1_name                      = "ICHG";
ADC121.adcMem1chansel                    = "DL_ADC12_INPUT_CHAN_1";
ADC121.enabledInterrupts                 = ["DL_ADC12_INTERRUPT_MEM1_RESULT_LOADED"];
ADC121.peripheral.$assign                = "ADC0";
ADC121.peripheral.adcPin0.$assign        = "PA27";
ADC121.peripheral.adcPin1.$assign        = "PA26";
ADC121.adcPin0Config.$name               = "ti_driverlib_gpio_GPIOPinGeneric0";
ADC121.adcPin0Config.hideOutputInversion = scripting.forceWrite(false);
ADC121.adcPin1Config.$name               = "ti_driverlib_gpio_GPIOPinGeneric1";

const Board = scripting.addModule("/ti/driverlib/Board", {}, false);

GPIO1.$name                                 = "GPIO_GRP_0";
GPIO1.associatedPins.create(10);
GPIO1.associatedPins[0].$name               = "LCD_SCL";
GPIO1.associatedPins[0].assignedPort        = "PORTB";
GPIO1.associatedPins[0].assignedPin         = "9";
GPIO1.associatedPins[0].initialValue        = "SET";
GPIO1.associatedPins[0].ioStructure         = "SD";
GPIO1.associatedPins[0].assignedPortSegment = "Lower";
GPIO1.associatedPins[1].$name               = "LCD_SDA";
GPIO1.associatedPins[1].assignedPort        = "PORTB";
GPIO1.associatedPins[1].assignedPin         = "8";
GPIO1.associatedPins[1].initialValue        = "SET";
GPIO1.associatedPins[1].ioStructure         = "SD";
GPIO1.associatedPins[1].assignedPortSegment = "Lower";
GPIO1.associatedPins[2].$name               = "LCD_RES";
GPIO1.associatedPins[2].assignedPort        = "PORTB";
GPIO1.associatedPins[2].assignedPin         = "14";
GPIO1.associatedPins[2].initialValue        = "SET";
GPIO1.associatedPins[2].ioStructure         = "SD";
GPIO1.associatedPins[2].assignedPortSegment = "Lower";
GPIO1.associatedPins[3].$name               = "LCD_DC";
GPIO1.associatedPins[3].initialValue        = "SET";
GPIO1.associatedPins[3].assignedPort        = "PORTB";
GPIO1.associatedPins[3].assignedPin         = "10";
GPIO1.associatedPins[3].ioStructure         = "SD";
GPIO1.associatedPins[3].assignedPortSegment = "Lower";
GPIO1.associatedPins[4].$name               = "LCD_CS";
GPIO1.associatedPins[4].assignedPort        = "PORTB";
GPIO1.associatedPins[4].assignedPin         = "11";
GPIO1.associatedPins[4].initialValue        = "SET";
GPIO1.associatedPins[4].ioStructure         = "SD";
GPIO1.associatedPins[4].assignedPortSegment = "Lower";
GPIO1.associatedPins[5].$name               = "LCD_BLK";
GPIO1.associatedPins[5].initialValue        = "SET";
GPIO1.associatedPins[5].assignedPort        = "PORTB";
GPIO1.associatedPins[5].assignedPin         = "26";
GPIO1.associatedPins[5].ioStructure         = "SD";
GPIO1.associatedPins[5].assignedPortSegment = "Upper";
GPIO1.associatedPins[6].$name               = "KEY_START";
GPIO1.associatedPins[6].initialValue        = "SET";
GPIO1.associatedPins[6].assignedPort        = "PORTB";
GPIO1.associatedPins[6].direction           = "INPUT";
GPIO1.associatedPins[6].assignedPin         = "21";
GPIO1.associatedPins[6].ioStructure         = "SD";
GPIO1.associatedPins[6].assignedPortSegment = "Upper";
GPIO1.associatedPins[6].internalResistor    = "PULL_UP";
GPIO1.associatedPins[7].$name               = "KEY_UP";
GPIO1.associatedPins[7].direction           = "INPUT";
GPIO1.associatedPins[7].ioStructure         = "SD";
GPIO1.associatedPins[7].assignedPort        = "PORTB";
GPIO1.associatedPins[7].assignedPortSegment = "Lower";
GPIO1.associatedPins[7].assignedPin         = "12";
GPIO1.associatedPins[8].$name               = "KE_DOWN";
GPIO1.associatedPins[8].direction           = "INPUT";
GPIO1.associatedPins[8].ioStructure         = "SD";
GPIO1.associatedPins[8].assignedPort        = "PORTB";
GPIO1.associatedPins[8].assignedPortSegment = "Lower";
GPIO1.associatedPins[8].assignedPin         = "13";
GPIO1.associatedPins[9].$name               = "KEY_MODE";
GPIO1.associatedPins[9].direction           = "INPUT";
GPIO1.associatedPins[9].ioStructure         = "SD";
GPIO1.associatedPins[9].assignedPort        = "PORTB";
GPIO1.associatedPins[9].assignedPortSegment = "Lower";
GPIO1.associatedPins[9].assignedPin         = "15";

PWM1.$name                              = "PWM_CHG";
PWM1.timerCount                         = 640;
PWM1.deadBandEn                         = true;
PWM1.dbRiseDelayTimerCount              = 16;
PWM1.dbFallDelayTimerCount              = 16;
PWM1.interrupts                         = ["ZERO_EVENT"];
PWM1.ccIndexCmpl                        = [0];
PWM1.ccIndex                            = [0];
PWM1.peripheral.$assign                 = "TIMA0";
PWM1.peripheral.ccp0Pin.$assign         = "PA21";
PWM1.peripheral.ccp0Pin_cmpl.$assign    = "PA22";
PWM1.PWM_CHANNEL_0.$name                = "ti_driverlib_pwm_PWMTimerCC0";
PWM1.ccp0PinConfig.direction            = scripting.forceWrite("OUTPUT");
PWM1.ccp0PinConfig.hideOutputInversion  = scripting.forceWrite(false);
PWM1.ccp0PinConfig.onlyInternalResistor = scripting.forceWrite(false);
PWM1.ccp0PinConfig.passedPeripheralType = scripting.forceWrite("Digital");
PWM1.ccp0PinConfig.$name                = "ti_driverlib_gpio_GPIOPinGeneric2";
PWM1.ccp0PinConfig.enableConfig         = true;
PWM1.ccp0Pin_cmplConfig.$name           = "ti_driverlib_gpio_GPIOPinGeneric3";
PWM1.ccp0Pin_cmplConfig.enableConfig    = true;

SYSCTL.forceDefaultClkConfig = true;

/**
 * Pinmux solution for unlocked pins/peripherals. This ensures that minor changes to the automatic solver in a future
 * version of the tool will not impact the pinmux you originally saw.  These lines can be completely deleted in order to
 * re-solve from scratch.
 */
Board.peripheral.$suggestSolution            = "DEBUGSS";
Board.peripheral.swclkPin.$suggestSolution   = "PA20";
Board.peripheral.swdioPin.$suggestSolution   = "PA19";
GPIO1.associatedPins[0].pin.$suggestSolution = "PB9";
GPIO1.associatedPins[1].pin.$suggestSolution = "PB8";
GPIO1.associatedPins[2].pin.$suggestSolution = "PB14";
GPIO1.associatedPins[3].pin.$suggestSolution = "PB10";
GPIO1.associatedPins[4].pin.$suggestSolution = "PB11";
GPIO1.associatedPins[5].pin.$suggestSolution = "PB26";
GPIO1.associatedPins[6].pin.$suggestSolution = "PB21";
GPIO1.associatedPins[7].pin.$suggestSolution = "PB12";
GPIO1.associatedPins[8].pin.$suggestSolution = "PB13";
GPIO1.associatedPins[9].pin.$suggestSolution = "PB15";
SYSCTL.peripheral.$suggestSolution           = "SYSCTL";
